## layers/meta-fetch-ai-demo/conf/layer.conf
```bitbake
BBPATH .= ":${LAYERDIR}"

BBFILES += "${LAYERDIR}/recipes-*/*/*.bb \
         ${LAYERDIR}/recipes-*/*/*.bbappend"

BBFILE_COLLECTIONS += "fetchaidemo"
BBFILE_PATTERN_fetchaidemo = "^${LAYERDIR}/"
BBFILE_PRIORITY_fetchaidemo = "5"
LAYERVERSION_fetchai = "1"
```
